## CMakeLists.txt
```
# SPDX-License-Identifier: Apache-2.0
# D-3 最小工厂闭环闸：WAMR 编译面同 tests/wasm（fast interp+配额+WASI
# 关+池 256KB）；工厂产物头经 FACTORY_PKG_HEADER 注入（默认=forge
# artifacts/run001）。板级 SRAM 预算：ENTELEA_NO_RAM_BACKEND=1（flash
# 后端为唯一持久面——同 hw_flash_persist 纪律）。
cmake_minimum_required(VERSION 3.20.0)

set(FACTORY_PKG_HEADER "/home/emb/project/workspace/forge/artifacts/run003/factory_pkg.h"
    CACHE STRING "Forge 工厂产物头（tsap_pack.py 生成）")
if(NOT EXISTS ${FACTORY_PKG_HEADER})
  message(FATAL_ERROR "factory package header missing: ${FACTORY_PKG_HEADER}")
endif()

if(TEST_FLASH_BACKEND)
  # 须在 find_package 前（DT 处理时序）：native_sim sim-flash 变体
  # storage 扩容（同 tests/store 纪律）。
  set(DTC_OVERLAY_FILE ${CMAKE_CURRENT_SOURCE_DIR}/flash.overlay)
endif()
find_package(Zephyr REQUIRED HINTS $ENV{ZEPHYR_BASE})
project(entelea_hw_factory_intake)

set(ENTELEA_ROOT ${CMAKE_CURRENT_SOURCE_DIR}/../../../..)
set(WAMR_DIR ${ENTELEA_ROOT}/../entelea-legacy/.deps/wamr)
if(NOT EXISTS ${WAMR_DIR}/core/iwasm/include/wasm_export.h)
  message(FATAL_ERROR "pinned WAMR checkout missing at ${WAMR_DIR}")
endif()

set(WAMR_BUILD_PLATFORM "zephyr")
if(CONFIG_64BIT OR BOARD_QUALIFIERS MATCHES "64")
  if(CMAKE_HOST_SYSTEM_PROCESSOR MATCHES "^(aarch64|arm64|ARM64)")
    set(WAMR_BUILD_TARGET "AARCH64")
  else()
    set(WAMR_BUILD_TARGET "X86_64")
  endif()
  set(WAMR_BUILD_INVOKE_NATIVE_GENERAL 0)
elseif(CONFIG_RISCV)
  # 板级 ESP32-P4 HP（rv32imafc/ABI ilp32f——r03-hwflash build.ninja
  # 实测）：fast interp 平台层最小面（无 AOT/JIT）。
  set(WAMR_BUILD_TARGET "RISCV32_ILP32F")
  set(WAMR_BUILD_INVOKE_NATIVE_GENERAL 1)
else()
  set(WAMR_BUILD_TARGET "X86_32")
  set(WAMR_BUILD_INVOKE_NATIVE_GENERAL 1)
endif()
set(WAMR_BUILD_INTERP 1)
set(WAMR_BUILD_FAST_INTERP 1)
set(WAMR_BUILD_AOT 0)
set(WAMR_BUILD_JIT 0)
set(WAMR_BUILD_LIBC_BUILTIN 1)
set(WAMR_BUILD_LIBC_WASI 0)
set(WAMR_BUILD_MULTI_MODULE 0)
set(WAMR_BUILD_LIB_PTHREAD 0)
set(WAMR_BUILD_SHARED_MEMORY 0)
set(WAMR_BUILD_GLOBAL_HEAP_POOL 1)
set(WAMR_BUILD_GLOBAL_HEAP_SIZE 262144)
set(WAMR_BUILD_INSTRUCTION_METERING 1)
set(WAMR_ROOT_DIR ${WAMR_DIR})
zephyr_include_directories(${ZEPHYR_BINARY_DIR}/include/generated/zephyr)
include(${WAMR_DIR}/build-scripts/runtime_lib.cmake)

get_filename_component(FACTORY_PKG_DIR ${FACTORY_PKG_HEADER} DIRECTORY)
zephyr_include_directories(${WAMR_DIR}/core/iwasm/include
                           ${ENTELEA_ROOT}/framework/include
                           ${ENTELEA_ROOT}/framework/services/package
                           ${ENTELEA_ROOT}/platform/zephyr
                           ${CMAKE_CURRENT_SOURCE_DIR}
                           ${FACTORY_PKG_DIR})
target_compile_definitions(app PRIVATE ENTELEA_NO_RAM_BACKEND=1)
target_sources(app PRIVATE
  main.c
  ${WAMR_RUNTIME_LIB_SOURCE}
  ${ENTELEA_ROOT}/platform/zephyr/boot_steps.c
  ${ENTELEA_ROOT}/platform/zephyr/clock.c
  ${ENTELEA_ROOT}/platform/zephyr/flash_store.c
  ${ENTELEA_ROOT}/framework/common/time.c
  ${ENTELEA_ROOT}/framework/services/storage/part.c
  ${ENTELEA_ROOT}/framework/services/storage/meta.c
  ${ENTELEA_ROOT}/framework/services/storage/noinit.c
  ${ENTELEA_ROOT}/framework/services/storage/audit.c
  ${ENTELEA_ROOT}/framework/services/storage/trust.c
  ${ENTELEA_ROOT}/framework/services/storage/kv.c
  ${ENTELEA_ROOT}/framework/services/config/prov.c
  ${ENTELEA_ROOT}/framework/services/config/prov_maint.c
  ${ENTELEA_ROOT}/framework/services/package/store.c
  ${ENTELEA_ROOT}/framework/services/package/crypto/tweetnacl.c
  ${ENTELEA_ROOT}/framework/services/package/wasm_host.c
  ${ENTELEA_ROOT}/framework/services/config/d12.c
  ${ENTELEA_ROOT}/framework/services/delivery/delivery.c
  ${ENTELEA_ROOT}/framework/execution/capability/perm.c
  ${ENTELEA_ROOT}/framework/runtime/supervision/events.c
  ${ENTELEA_ROOT}/framework/runtime/supervision/wdt.c
  ${ENTELEA_ROOT}/framework/runtime/supervision/boot.c
  ${ENTELEA_ROOT}/framework/execution/safety/channel.c
  ${ENTELEA_ROOT}/framework/execution/safety/commit.c
  ${ENTELEA_ROOT}/framework/execution/safety/force.c
  ${ENTELEA_ROOT}/framework/execution/safety/drivers.c
)
# WAMR zephyr 平台层引用旧 __stdout_hook_install（minimal-libc 链接垫片）
if(NOT CONFIG_PICOLIBC)
  target_sources(app PRIVATE src/wamr_compat.c)
endif()
set_source_files_properties(${WAMR_RUNTIME_LIB_SOURCE} PROPERTIES COMPILE_OPTIONS "-w")
if(NOT CONFIG_64BIT)
  set_source_files_properties(${WAMR_RUNTIME_LIB_SOURCE} PROPERTIES
    COMPILE_OPTIONS "-w;-Wa,--noexecstack")
endif()
```

## prj.conf
```kconfig
# SPDX-License-Identifier: Apache-2.0
# D-3 工厂闭环闸（native_sim 变体的 flash 面经 EXTRA_CONF_FILE 叠加）。
CONFIG_TEST_RANDOM_GENERATOR=y
# 板级：flash 存储后端（同 hw_flash_persist 纪律）+ 看门狗闸测参数
# （§10.2-C3 已追认三元组）。
CONFIG_FLASH=y
CONFIG_FLASH_MAP=y
CONFIG_TASK_WDT=y
CONFIG_WATCHDOG=y
CONFIG_TASK_WDT_HW_FALLBACK=y
CONFIG_TASK_WDT_MIN_TIMEOUT=3000
CONFIG_TASK_WDT_HW_FALLBACK_DELAY=2000
# 验签深栈（pkg_verify raw[512]+tweetnacl ed25519 open——板级实测
# Illegal instruction=main 栈溢出 PC 落 z_main_stack）。
CONFIG_MAIN_STACK_SIZE=8192
```

## prj-flash.conf
```kconfig
# SPDX-License-Identifier: Apache-2.0
# native_sim sim-flash 变体（同 tests/store 板级批纪律）。
CONFIG_FLASH=y
CONFIG_FLASH_MAP=y
CONFIG_FLASH_SIMULATOR=y
```

## app.overlay
```dts
/* SPDX-License-Identifier: Apache-2.0 */
/* 板级 flash 布局（同 hw_flash_persist 板级批）：镜像缩 slot0 至 1MB，
 * storage 扩 1MB@0x120000（SLOT_A/B 各 256KB + meta/kv/audit/prov/trust
 * ——工厂闭环两包槽全保留）。slot1 重叠注记同 hw_flash_persist。 */
&slot0_partition {
	reg = <0x00020000 0x00100000>;
};

&storage_partition {
	reg = <0x00120000 0x00100000>;
};
```

## flash.overlay
```dts
/* SPDX-License-Identifier: Apache-2.0 */
/* native_sim sim-flash 变体（同 tests/store 板级批）：storage 扩尾段
 * 1064KB + 写块 4（SLOT_A/B 256KB×2 + 其余区）。 */
&storage_partition {
	reg = <0x000fc000 0x00104000>;
};
&flash0 {
	write-block-size = <4>;
};
```

## src/wamr_compat.c
```c
/* SPDX-License-Identifier: Apache-2.0 */
/* 与 platform/zephyr/tests/wasm/src/wamr_compat.c 逐字节同步
 * （review P3-6 注记：漂移由闸/测试双构建面暴露）。 */
/* WAMR × Zephyr 4.4 兼容垫片（M2b.2a，零上游补丁纪律）。
 * WAMR-2.4.5 的 zephyr 平台层（core/shared/platform/zephyr/zephyr_platform.c）
 * 调用 Zephyr ≥3.x 已移除的 __stdout_hook_install（旧 printf 钩子机制）；
 * Zephyr 4.4 下 printk 原生可用，钩子无需安装——本垫片仅满足链接符号。
 * picolibc 的 Zephyr 集成自带同名符号（lib/libc/picolibc/stdio.c），垫片仅对
 * 无该实现的 libc（minimal-libc，native_sim 基线）编译（xiao_esp32s3 实证 2026-09-26）。
 * 升级 WAMR 后若平台层不再引用，可移除（撤垫片须重建复测，DR-22 纪律）。 */
#include <zephyr/kernel.h>

#if !defined(CONFIG_PICOLIBC)
void __stdout_hook_install(int (*hook)(int));

void __stdout_hook_install(int (*hook)(int))
{
	ARG_UNUSED(hook);
}
#endif

/* xtensa 软 8 字节原子族（V2 纵深 M19a，DEC-55）：TS_APP_THREADS 开启
 * WASM_ENABLE_SHARED_MEMORY 后解释器 i64.atomic 路径引用 GCC __atomic_*_8
 * 助手；xtensa（32 位）无原生 8 字节原子且 SDK 无 libatomic——irq_lock
 * 关中断实现（单核 V1 语义足够；native_sim/x86 由 GCC 内联展开不经此）。
 * 零上游补丁纪律：垫片于我方模块侧。 */
#if defined(CONFIG_TS_APP_THREADS) && defined(CONFIG_XTENSA)
#include <zephyr/irq.h>

uint64_t __atomic_load_8(const volatile void *ptr, int memorder)
{
	ARG_UNUSED(memorder);
	const volatile uint64_t *p = ptr;
	unsigned int key = irq_lock();
	uint64_t v = *p;

	irq_unlock(key);
	return v;
}

void __atomic_store_8(volatile void *ptr, uint64_t val, int memorder)
{
	ARG_UNUSED(memorder);
	volatile uint64_t *p = ptr;
	unsigned int key = irq_lock();

	*p = val;
	irq_unlock(key);
}

uint64_t __atomic_exchange_8(volatile void *ptr, uint64_t val, int memorder)
{
	ARG_UNUSED(memorder);
	volatile uint64_t *p = ptr;
	unsigned int key = irq_lock();
	uint64_t old = *p;

	*p = val;
	irq_unlock(key);
	return old;
}

bool __atomic_compare_exchange_8(volatile void *ptr, void *expected,
				  uint64_t desired, int weak,
				  int success_mo, int failure_mo)
{
	ARG_UNUSED(weak);
	ARG_UNUSED(success_mo);
	ARG_UNUSED(failure_mo);
	volatile uint64_t *p = ptr;
	uint64_t *exp = expected;
	unsigned int key = irq_lock();
	bool ok = *p == *exp;

	if (ok) {
		*p = desired;
	} else {
		*exp = *p;
	}
	irq_unlock(key);
	return ok;
}
#endif
```
