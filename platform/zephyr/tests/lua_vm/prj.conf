## CMakeLists.txt
```
# SPDX-License-Identifier: Apache-2.0
# D03 Lua feasibility on the real, pinned Lua interpreter (.deps/lua).
# Opt-in experiment, off by default:
#   --cmake-arg=-DLUA_VM_FEASIBILITY=ON
# It is not a Lua runtime and is never linked into a product image.
if(NOT LUA_VM_FEASIBILITY)
  message(FATAL_ERROR
    "lua_vm is an opt-in experiment: pass --cmake-arg=-DLUA_VM_FEASIBILITY=ON")
endif()
cmake_minimum_required(VERSION 3.20.0)
find_package(Zephyr REQUIRED HINTS $ENV{ZEPHYR_BASE})
project(entelea_tests_lua_vm)

set(ENTELEA_ROOT ${CMAKE_CURRENT_SOURCE_DIR}/../../../..)
set(LUA_DIR ${ENTELEA_ROOT}/.deps/lua)

# The interpreter must be the pinned, unmodified checkout: the repository's
# read-only checker verifies it before anything is compiled.
execute_process(
  COMMAND ${Python3_EXECUTABLE} ${ENTELEA_ROOT}/tools/check_dependencies.py
          --dependency lua --checkout ${LUA_DIR}
  RESULT_VARIABLE lua_pinned
  OUTPUT_VARIABLE lua_out
  ERROR_VARIABLE lua_out
)
if(NOT lua_pinned EQUAL 0)
  message(FATAL_ERROR "pinned Lua checkout missing or modified: ${lua_out}")
endif()

# Core, auxiliary library and every standard library. Excluded on purpose:
# linit (the open-everything entry; the harness opens the libraries itself)
# plus the standalone interpreters lua.c and onelua.c. ldblib is compiled for
# the hazard demonstration only; the harness never opens it for a sandbox.
set(LUA_PARTS
  lapi lcode lctype ldebug ldo ldump lfunc lgc llex lmem lobject lopcodes
  lparser lstate lstring ltable ltm lundump lvm lzio lauxlib
  lbaselib lcorolib lmathlib lstrlib ltablib lutf8lib ldblib
  liolib loslib loadlib)
set(LUA_SOURCES "")
foreach(part IN LISTS LUA_PARTS)
  list(APPEND LUA_SOURCES ${LUA_DIR}/${part}.c)
endforeach()

# Stock Lua allows 200 nested C calls and syntax levels (LUAI_MAXCCALLS). It
# is a compile-time choice of the interpreter, so a lower limit is measured
# with it, not by editing the pinned sources.
set(LUA_VM_MAXCCALLS 200 CACHE STRING "LUAI_MAXCCALLS of the pinned Lua (stock: 200)")
# The interpreter runs on a dedicated kernel heap of LUA_VM_HEAP_KB, and the
# harness checks a memory quota of LUA_VM_QUOTA_KB against it (never larger).
# The harness runs on its own thread with a stack of LUA_VM_STACK_KB: Lua's
# parser and C-level nesting use the C stack, and the stock nesting limit of
# 200 needs about 294 KB of it on the ESP32-P4. With CONFIG_ESP_SPIRAM=y the
# heap buffer and that stack are placed in PSRAM.
set(LUA_VM_HEAP_KB 320 CACHE STRING "kernel heap under the interpreter, in KB")
set(LUA_VM_QUOTA_KB 256 CACHE STRING "memory quota under test, in KB")
set(LUA_VM_STACK_KB 1024 CACHE STRING "stack of the harness thread, in KB")

zephyr_include_directories(${ENTELEA_ROOT}/framework/include ${LUA_DIR})
zephyr_library_named(entelea_lua)
zephyr_library_sources(${LUA_SOURCES})
# Upstream Lua keeps its own formatting and warning baseline.
set_source_files_properties(${LUA_SOURCES} PROPERTIES COMPILE_OPTIONS "-w"
  COMPILE_DEFINITIONS LUAI_MAXCCALLS=${LUA_VM_MAXCCALLS})

target_sources(app PRIVATE
  src/main.c
  src/feasibility.c
  # The contract's memory and step gates the harness attaches to the VM,
  # and the real principal and event modules behind the host call.
  ${ENTELEA_ROOT}/framework/services/package/lua_feasibility.c
  ${ENTELEA_ROOT}/framework/execution/capability/perm.c
  ${ENTELEA_ROOT}/framework/runtime/supervision/events.c
)
# A board image has no filesystem nor process clock, which stock Lua
# references; the simulator image links the host libc instead.
if(NOT CONFIG_BOARD_NATIVE_SIM)
  target_sources(app PRIVATE src/no_fs_stubs.c)
endif()
# The PSRAM rail is powered by the board definition: it declares the internal
# LDO channel in the devicetree and enables the regulator driver, so the
# kernel's PSRAM init finds the rail already on (upstream route).
target_link_libraries(app PRIVATE entelea_lua)
target_compile_definitions(app PRIVATE ENTELEA_TEST=1
  LUA_VM_MAXCCALLS=${LUA_VM_MAXCCALLS} LUA_VM_HEAP_KB=${LUA_VM_HEAP_KB}
  LUA_VM_QUOTA_KB=${LUA_VM_QUOTA_KB} LUA_VM_STACK_KB=${LUA_VM_STACK_KB})
```

## prj.conf
```kconfig
# SPDX-License-Identifier: Apache-2.0
CONFIG_ZTEST=y
# The interpreter's heap is 320 KB by default. The simulator selects the small
# implementation by default, which cannot hold more than about 128 KB on a
# 32-bit target and halts at boot when asked to; a board already selects the
# automatic choice.
CONFIG_SYS_HEAP_AUTO=y
# Firmware-like code size (-Os) so the footprint numbers are representative.
CONFIG_SIZE_OPTIMIZATIONS=y
```

## src/main.c
```c
/* SPDX-License-Identifier: Apache-2.0 */
/*
 * D03 Lua feasibility on the real interpreter (Zephyr only). The single
 * case asserts that every check behaved as the integration contract expects;
 * the measured values are in the "[lua-feas]" lines. Opt-in experiment:
 * build with -DLUA_VM_FEASIBILITY=ON (see docs/lua-feasibility.md).
 */
#include <zephyr/ztest.h>
#include "feasibility.h"

ZTEST(lua_feas, test_contract_holds_on_the_real_interpreter)
{
	uint32_t failed = entelea_lua_feasibility_run();

	/* Each bit of the mask names one check that did not behave as the
	 * contract expects; see feasibility.c. */
	zassert_equal(failed, 0, "failed mask 0x%x", failed);
}

ZTEST_SUITE(lua_feas, NULL, NULL, NULL, NULL, NULL);
```

## src/feasibility.h
```c
/* SPDX-License-Identifier: Apache-2.0 */
#ifndef ENTELEA_LUA_VM_FEASIBILITY_H
#define ENTELEA_LUA_VM_FEASIBILITY_H

#include <stdint.h>

/* D03 Lua feasibility on the real interpreter (Zephyr only; opt-in
 * experiment, see docs/lua-feasibility.md). Prints one "[lua-feas]" line
 * per check and returns the failed-check mask: 0 when every check behaved
 * as the integration contract expects. */
uint32_t
entelea_lua_feasibility_run(void);

#endif /* ENTELEA_LUA_VM_FEASIBILITY_H */
```

## src/no_fs_stubs.c
```c
/* SPDX-License-Identifier: Apache-2.0 */
/*
 * Board images of this experiment have no filesystem and no process clock.
 * Stock Lua reaches for both from its file loaders (lauxlib.c:
 * luaL_loadfilex), from the io and os libraries that are open for a script
 * (fopen, and through the libc open/read/write/lseek/close, remove, rename,
 * tmpfile and clock) and fail closed: nothing is ever opened, read, written,
 * removed or renamed, and no processor time is ever reported. The simulator
 * image needs none of them, as its libc is the host's.
 *
 * The prototypes are those of the ILP32 ABI, where ssize_t and off_t are as
 * wide as int; Zephyr declares them only with its POSIX and filesystem
 * options, which this image does not enable.
 */
#include <errno.h>
#include <stdarg.h>
#include <time.h>

int
open(const char *path, int oflag, ...)
{
	va_list ap;

	(void) path;
	(void) oflag;
	va_start(ap, oflag);
	va_end(ap);
	errno = ENOENT;
	return -1;
}

int
close(int fd)
{
	(void) fd;
	errno = EBADF;
	return -1;
}

int
read(int fd, void *buf, unsigned int count)
{
	(void) fd;
	(void) buf;
	(void) count;
	errno = EBADF;
	return -1;
}

int
write(int fd, const void *buf, unsigned int count)
{
	(void) fd;
	(void) buf;
	(void) count;
	errno = EBADF;
	return -1;
}

int
lseek(int fd, int offset, int whence)
{
	(void) fd;
	(void) offset;
	(void) whence;
	errno = ESPIPE;
	return -1;
}

int
unlink(const char *path)
{
	(void) path;
	errno = ENOENT;
	return -1;
}

int
rename(const char *oldpath, const char *newpath)
{
	(void) oldpath;
	(void) newpath;
	errno = ENOENT;
	return -1;
}

/* There is no process clock either: os.clock reports that no processor time
 * was spent, and the libc clock() needs nothing beyond this. */
clock_t
clock(void)
{
	return (clock_t) 0;
}
```

## src/psram_power.c
```c
/* SPDX-License-Identifier: Apache-2.0 */
/*
 * For boards with PSRAM only.
 *
 * The in-package PSRAM of the ESP32-P4 and its PLL are fed from the chip's
 * internal LDO channel 2 (1.8 V). ESP-IDF enables that channel from
 * esp_clk_tree_mpll_acquire(), which is its default (ESP_LDO_RESERVE_PSRAM).
 * The Zephyr port compiles the same code without that option and expects a
 * board to declare the channel as a regulator instead. This board declares
 * none, so the driver ran with the PSRAM unpowered and every read returned
 * 0x3b3b3b3b.
 *
 * This powers the channel before the kernel initializes PSRAM, the way
 * ESP-IDF does. It stands in for the board port for as long as the board
 * definition leaves the channel out: enabling Zephyr's regulator driver for
 * it brings in the PMU clock driver, which does not boot on this board.
 */
#include <zephyr/init.h>
#include "esp_rom_sys.h"
#include "hal/ldo_ll.h"

#define PSRAM_LDO_CHANNEL 2
#define PSRAM_LDO_MILLIVOLTS 1800
/* The settle time ESP-IDF waits after switching the channel on. */
#define LDO_STABLE_DELAY_US 200
/* Right before the kernel's own PSRAM initialization, which runs at the
 * default priority. The init macros paste their priority into a section
 * name, so it has to be a plain number. */
#define PSRAM_POWER_PRIORITY 39
BUILD_ASSERT(CONFIG_KERNEL_INIT_PRIORITY_DEFAULT == PSRAM_POWER_PRIORITY + 1,
	     "the kernel's PSRAM init moved; keep this one step before it");

static int
psram_power(void)
{
	int unit = LDO_ID2UNIT(PSRAM_LDO_CHANNEL);
	uint8_t dref = 0;
	uint8_t mul = 0;
	bool rail = false;

	ldo_ll_set_owner(unit, LDO_LL_UNIT_OWNER_SW);
	ldo_ll_enable_ripple_suppression(unit, true);
	ldo_ll_voltage_to_dref_mul(unit, PSRAM_LDO_MILLIVOLTS, &dref, &mul,
				   &rail);
	ldo_ll_adjust_voltage(unit, dref, mul, rail);
	ldo_ll_enable(unit, true);
	esp_rom_delay_us(LDO_STABLE_DELAY_US);
	return 0;
}

SYS_INIT(psram_power, PRE_KERNEL_1, PSRAM_POWER_PRIORITY);
```
