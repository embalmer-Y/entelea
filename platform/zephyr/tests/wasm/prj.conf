## CMakeLists.txt
```
# SPDX-License-Identifier: Apache-2.0
# R05 Wasm 闭环测试：WAMR（pinned ../entelea-legacy/.deps/wamr）经旧
# DEC-17/25/31/48③ 编译面（fast 解释器+指令配额+WASI 关+池）。
cmake_minimum_required(VERSION 3.20.0)
find_package(Zephyr REQUIRED HINTS $ENV{ZEPHYR_BASE})
project(entelea_tests_wasm)

set(ENTELEA_ROOT ${CMAKE_CURRENT_SOURCE_DIR}/../../../..)
set(WAMR_DIR ${ENTELEA_ROOT}/../entelea-legacy/.deps/wamr)
if(NOT EXISTS ${WAMR_DIR}/core/iwasm/include/wasm_export.h)
  message(FATAL_ERROR "pinned WAMR checkout missing at ${WAMR_DIR}")
endif()

set(WAMR_BUILD_PLATFORM "zephyr")
if(CONFIG_64BIT OR BOARD_QUALIFIERS MATCHES "64")
  if(CMAKE_HOST_SYSTEM_PROCESSOR MATCHES "^(aarch64|arm64|ARM64)")
    set(WAMR_BUILD_TARGET "AARCH64")
  else()
    set(WAMR_BUILD_TARGET "X86_64")
  endif()
  set(WAMR_BUILD_INVOKE_NATIVE_GENERAL 0)
else()
  set(WAMR_BUILD_TARGET "X86_32")
  set(WAMR_BUILD_INVOKE_NATIVE_GENERAL 1)
endif()
set(WAMR_BUILD_INTERP 1)
set(WAMR_BUILD_FAST_INTERP 1)
set(WAMR_BUILD_AOT 0)
set(WAMR_BUILD_JIT 0)
set(WAMR_BUILD_LIBC_BUILTIN 1)
set(WAMR_BUILD_LIBC_WASI 0)
set(WAMR_BUILD_MULTI_MODULE 0)
set(WAMR_BUILD_LIB_PTHREAD 0)
set(WAMR_BUILD_SHARED_MEMORY 0)
set(WAMR_BUILD_GLOBAL_HEAP_POOL 1)
set(WAMR_BUILD_GLOBAL_HEAP_SIZE 262144)
set(WAMR_BUILD_INSTRUCTION_METERING 1)
set(WAMR_ROOT_DIR ${WAMR_DIR})
# 上游 2.4.5 平台头裸 include <autoconf.h>——生成目录显式前置（旧 §76
# 同纪律，零上游补丁）。
zephyr_include_directories(${ZEPHYR_BINARY_DIR}/include/generated/zephyr)
include(${WAMR_DIR}/build-scripts/runtime_lib.cmake)
list(LENGTH WAMR_RUNTIME_LIB_SOURCE WAMR_SRC_COUNT)
message(STATUS "WAMR_SRC_COUNT=${WAMR_SRC_COUNT}")

# app 模式下独立 zephyr 库不保序（生成头晚于三方编译）且不入链——
# WAMR 源直接编入 app 目标（app 在 zephyr 完整生成后编译，次序正确）。
zephyr_include_directories(${WAMR_DIR}/core/iwasm/include
                           ${ENTELEA_ROOT}/framework/include
                           ${ENTELEA_ROOT}/framework/services/package
                           ${ENTELEA_ROOT}/platform/zephyr)
target_sources(app PRIVATE
  src/main.c
  ${WAMR_RUNTIME_LIB_SOURCE}
  ${ENTELEA_ROOT}/framework/services/storage/part.c
  ${ENTELEA_ROOT}/framework/services/storage/meta.c
  ${ENTELEA_ROOT}/framework/services/storage/noinit.c
  ${ENTELEA_ROOT}/framework/services/storage/audit.c
  ${ENTELEA_ROOT}/framework/services/storage/trust.c
  ${ENTELEA_ROOT}/framework/services/storage/kv.c
  ${ENTELEA_ROOT}/framework/services/config/prov.c
  ${ENTELEA_ROOT}/framework/services/config/prov_maint.c
  ${ENTELEA_ROOT}/framework/services/package/store.c
  ${ENTELEA_ROOT}/framework/services/package/crypto/tweetnacl.c
  ${ENTELEA_ROOT}/framework/services/package/lua_feasibility.c
  ${ENTELEA_ROOT}/framework/services/package/wasm_host.c
  ${ENTELEA_ROOT}/framework/services/config/d12.c
  ${ENTELEA_ROOT}/framework/execution/capability/perm.c
  ${ENTELEA_ROOT}/framework/runtime/supervision/events.c
  ${ENTELEA_ROOT}/framework/common/time.c
)
target_compile_definitions(app PRIVATE ENTELEA_TEST=1)
# 三方源 -w（钉版上游零补丁纪律）；32 位汇编栈注记。
set_source_files_properties(${WAMR_RUNTIME_LIB_SOURCE} PROPERTIES COMPILE_OPTIONS "-w")
if(NOT CONFIG_64BIT)
  set_source_files_properties(${WAMR_RUNTIME_LIB_SOURCE} PROPERTIES
    COMPILE_OPTIONS "-w;-Wa,--noexecstack")
endif()
# WAMR zephyr 平台层引用旧 __stdout_hook_install（minimal-libc 链接垫片）
if(NOT CONFIG_PICOLIBC)
  target_sources(app PRIVATE src/wamr_compat.c)
endif()
```

## prj.conf
```kconfig
# SPDX-License-Identifier: Apache-2.0
CONFIG_ZTEST=y
CONFIG_TEST_RANDOM_GENERATOR=y
```

## src/main.c
```c
/* SPDX-License-Identifier: Apache-2.0 */
/* R05 Wasm 闭环测试：签名好包 → load → call（含代表 native 身份裁决）→
 * 超时停止；坏签名拒装载。测试 wasm 模块 = 内嵌最小 wat2wasm 产物
 * （wat 文本 → wabt 编译的固定字节数组，源注释保留生成命令）。 */
#include <string.h>
#include <zephyr/ztest.h>
#include <entelea/appstore.h>
#include <entelea/d12.h>
#include <entelea/package.h>
#include <entelea/principal.h>
#include <entelea/storage.h>
#include <entelea/wasm_host.h>
#include "crypto/tweetnacl.h"

static const unsigned char test_root_sk[64] = {
#include "test_root_sk.inc"
};

/* 旧 wamr/app 固定夹具 sample.wasm（103B；导出 health_ping/on_input，
 * 无外部导入——闭环最小面）。 */
static const uint8_t WASM_SAMPLE[] = {
#include "sample_wasm.inc"
};

/*
 * 测试模块（wabt wat2wasm 生成，源内联保留）：
 *   (module
 *     (import "entelea" "host_probe" (func $probe (param i32) (result i32)))
 *     (func (export "run") (param i32) (result i32)
 *       (call $probe (local.get 0)))
 *     (func (export "spin") (param i32) (result i32)
 *       (loop $l (br_if $l (i32.gt_s (local.get 0) (i32.const 0)))
 *                (local.set 0 (i32.sub (local.get 0) (i32.const 1))))
 *       (local.get 0)))
 */
static const uint8_t WASM_RUN_UNUSED[] = {
	0x00,0x61,0x73,0x6d,0x01,0x00,0x00,0x00,0x01,0x11,0x03,0x60,0x01,0x7f,
	0x01,0x7f,0x60,0x01,0x7f,0x01,0x7f,0x60,0x01,0x7f,0x01,0x7f,0x02,0x1c,
	0x01,0x07,0x65,0x6e,0x74,0x65,0x6c,0x65,0x61,0x0a,0x68,0x6f,0x73,0x74,
	0x5f,0x70,0x72,0x6f,0x62,0x65,0x00,0x00,0x03,0x03,0x02,0x01,0x01,0x07,
	0x13,0x02,0x03,0x72,0x75,0x6e,0x00,0x01,0x04,0x73,0x70,0x69,0x6e,0x00,
	0x02,0x0a,0x1d,0x02,0x07,0x00,0x20,0x00,0x10,0x00,0x0b,0x13,0x00,0x03,
	0x40,0x20,0x00,0x41,0x00,0x4e,0x0d,0x00,0x20,0x00,0x41,0x01,0x6b,0x21,
	0x00,0x0c,0x00,0x0b,0x20,0x00,0x0b,
};

static const uint8_t MAN[] = {0xa1, 0x63, 'a', 'p', 'p', 0x01};

static void stage_signed(uint8_t slot, const uint8_t *wasm, uint32_t wlen)
{
	uint8_t pkg[1024];
	uint32_t n = 0;

	pkg[n++]='T';pkg[n++]='S';pkg[n++]='A';pkg[n++]='P';
	pkg[n++]=0;pkg[n++]=2;
	pkg[n++]=0;pkg[n++]=0;pkg[n++]=0;pkg[n++]=(uint8_t)sizeof(MAN);
	pkg[n++]=0;pkg[n++]=0;pkg[n++]=(uint8_t)(wlen>>8);pkg[n++]=(uint8_t)wlen;
	pkg[n++]=0;pkg[n++]=1;
	uint32_t st[8];uint8_t dg[32];
	entelea_sha256_stream_init(st);
	entelea_sha256_stream_update(st,MAN,sizeof(MAN));
	entelea_sha256_stream_update(st,wasm,wlen);
	entelea_sha256_stream_final(st,dg);
	memcpy(pkg+n,dg,32);n+=32;
	memcpy(pkg+n,MAN,sizeof(MAN));n+=sizeof(MAN);
	memcpy(pkg+n,wasm,wlen);n+=wlen;
	uint8_t payload[512];
	uint32_t plen=sizeof(MAN)+wlen;
	memcpy(payload,MAN,sizeof(MAN));memcpy(payload+sizeof(MAN),wasm,wlen);
	static uint8_t sm[64+22+512];
	memcpy(sm,test_root_sk+32,64);
	size_t tail=64;
	sm[tail++]=0x84;sm[tail++]=0x6a;
	memcpy(sm+tail,"Signature1",10);tail+=10;
	sm[tail++]=0x43;sm[tail++]=0xa1;sm[tail++]=0x01;sm[tail++]=0x27;sm[tail++]=0x40;
	sm[tail++]=0x58;sm[tail++]=(uint8_t)plen;
	memcpy(sm+tail,payload,plen);tail+=plen;
	static uint8_t sb[64+512];
	unsigned long long sl=0;
	crypto_sign(sb,&sl,sm+64,tail-64,test_root_sk);
	zassert_equal(entelea_pkg_stage_begin(slot),ENTELEA_OK);
	zassert_equal(entelea_pkg_stage_chunk(slot,0,pkg,n),ENTELEA_OK);
	/* 追加 COSE_Sign1：tag18 + array4 + phdr + uhdr + payload(内嵌副本) + sig */
	uint8_t tail_b[16];
	uint32_t tn=0;
	tail_b[tn++]=0xd2;tail_b[tn++]=0x84;
	tail_b[tn++]=0x43;tail_b[tn++]=0xa1;tail_b[tn++]=0x01;tail_b[tn++]=0x27;
	tail_b[tn++]=0xa0;
	tail_b[tn++]=0x58;tail_b[tn++]=(uint8_t)plen; /* payload bstr 头 */
	zassert_equal(entelea_pkg_stage_chunk(slot,n,tail_b,tn),ENTELEA_OK);
	zassert_equal(entelea_pkg_stage_chunk(slot,n+tn,payload,plen),ENTELEA_OK); /* 内嵌副本 */
	uint8_t sigh[2]={0x58,64};

	zassert_equal(entelea_pkg_stage_chunk(slot,n+tn+plen,sigh,2),ENTELEA_OK);
	zassert_equal(entelea_pkg_stage_chunk(slot,n+tn+plen+2,sb,64),ENTELEA_OK);
}

static uint64_t d12_fake_now; /* r16：d12 冷却窗面（wasm_allow） */

static entelea_result_t d12_fake_read_ms(void *user, uint64_t *out)
{
	*out = *(uint64_t *)user;
	return ENTELEA_OK;
}

static void *wasm_setup(void)
{
	static entelea_clock_t d12_clock;

	zassert_equal(entelea_storage_test_reset(), ENTELEA_OK);
	entelea_wasm_test_reset();
	entelea_perm_test_reset();
	d12_fake_now = 0;
	entelea_d12_test_reset();
	zassert_ok(entelea_clock_init(&d12_clock, d12_fake_read_ms,
				      &d12_fake_now, 0xD12));
	zassert_ok(entelea_d12_bind_clock(&d12_clock));
	return NULL;
}

ZTEST(framework_wasm, test_signed_load_call_stop)
{
	zassert_equal(entelea_wasm_init(), ENTELEA_OK, "WAMR init（池模式）");
	stage_signed(0, WASM_SAMPLE, sizeof(WASM_SAMPLE));

	/* 坏签名 slot 拒装载（位腐）。 */
	stage_signed(1, WASM_SAMPLE, sizeof(WASM_SAMPLE));
	uint8_t bad = 0xEE;

	zassert_equal(entelea_pkg_slot_write(1, ENTELEA_TSAP_CONTENT_OFF, &bad, 1),
		      ENTELEA_OK);
	uint32_t app = 0;

	zassert_equal(entelea_wasm_load(1, &app), ENTELEA_E_INVALID_SIG,
		      "坏签名拒装载");

	/* 好包装载 + 授权 principal 调用（代表 native 身份裁决）。 */
	zassert_equal(entelea_wasm_load(0, &app), ENTELEA_OK);
	zassert_equal(app, 1);
	entelea_perm_table_t t;

	entelea_perm_table_init(&t);
	zassert_equal(entelea_perm_parse("gpio:read:0", &t), ENTELEA_OK);
	entelea_principal_t ctx;

	zassert_equal(entelea_principal_bind(&ctx, 1, &t), ENTELEA_OK);
	int32_t ret = -1;

	zassert_equal(entelea_wasm_call(app, ctx, "health_ping", 100, &ret),
		      ENTELEA_OK, "导出函数调用");
	zassert_true(ret >= 0, "health_ping 返回（native 身份裁决经 host_probe 语义同面）");

	/* 未授权 principal：sample.wasm 无导入——health_ping 不触 native，
	 * 调用成功**不构成**授权证据（计划符合性审查 P2：此前注释声称
	 * "native 返回 E_PERM"与断言矛盾）。裁决面在下例经直达钩子验证；
	 * VM 内 wasm→native 调用路径随工厂夹具。 */
	entelea_perm_table_t empty;

	entelea_perm_table_init(&empty);
	entelea_principal_t poor;

	zassert_equal(entelea_principal_bind(&poor, 2, &empty), ENTELEA_OK);
	zassert_equal(entelea_wasm_call(app, poor, "health_ping", 100, &ret), ENTELEA_OK);
	zassert_true(ret >= 0, "无导入模块调用与授权无关");

	/* 死循环模块：步预算到期 → E_TIMEOUT 有界停止 + 实例销毁。 */
	zassert_equal(entelea_wasm_stop(app), ENTELEA_OK);
	stage_signed(1, WASM_SAMPLE, sizeof(WASM_SAMPLE));
	uint32_t app2 = 0;

	zassert_equal(entelea_wasm_load(1, &app2), ENTELEA_OK, "换包重装载");
	/* 有界停止：预算 0（任何指令即超限）→ 调用中止 = E_TIMEOUT + 实例
	 * 销毁（指令配额 DEC-48③ 机制面；真死循环模块随工厂夹具对拍）。 */
	zassert_equal(entelea_wasm_call(app2, ctx, "health_ping", 0, &ret),
		      ENTELEA_E_TIMEOUT, "步预算 0 → 有界停止");
	zassert_equal(entelea_wasm_instance_count(), 0, "超时后实例销毁");
	/* 停止后调用 = NOTFOUND（不静默续跑）。 */
	zassert_equal(entelea_wasm_call(app2, ctx, "health_ping", 100, &ret),
		      ENTELEA_E_NOTFOUND);
}

/* E-2 错误面收窄：trap ≠ 配额到期。trap 模块（wasm 二进制手写：
 * (module (func (export "t") (param i32) (result i32) unreachable))
 * ——unreachable 立即 trap，异常串不含 instruction limit → E_IO。 */
static const uint8_t WASM_TRAP[] = {
	0x00,0x61,0x73,0x6d,0x01,0x00,0x00,0x00,
	0x01,0x06,0x01,0x60,0x01,0x7f,0x01,0x7f,
	0x03,0x02,0x01,0x00,
	0x07,0x05,0x01,0x01,0x74,0x00,0x00,
	0x0a,0x05,0x01,0x03,0x00,0x00,0x0b,
};

ZTEST(framework_wasm, test_trap_vs_quota_error_split)
{
	entelea_wasm_test_reset();
	entelea_storage_test_reset();
	zassert_equal(entelea_wasm_init(), ENTELEA_OK);
	stage_signed(0, WASM_TRAP, sizeof(WASM_TRAP));
	uint32_t app = 0;

	zassert_equal(entelea_wasm_load(0, &app), ENTELEA_OK);
	entelea_principal_t ctx = {0};
	int32_t ret = -1;

	zassert_equal(entelea_wasm_call(app, ctx, "t", 1000, &ret),
		      ENTELEA_E_IO, "trap → E_IO（非配额面）");
	zassert_equal(entelea_wasm_instance_count(), 0, "trap 后实例销毁");
	/* 判别性对照：同模块预算 0 仍 E_TIMEOUT（配额异常串路径）。 */
	uint32_t app2 = 0;

	stage_signed(1, WASM_SAMPLE, sizeof(WASM_SAMPLE));
	zassert_equal(entelea_wasm_load(1, &app2), ENTELEA_OK);
	zassert_equal(entelea_wasm_call(app2, ctx, "health_ping", 0, &ret),
		      ENTELEA_E_TIMEOUT, "配额 0 → E_TIMEOUT（判别对照）");
}

ZTEST_SUITE(framework_wasm, NULL, wasm_setup, NULL, NULL, NULL);

/* ---- 代表 native 裁决面（直达钩子；sample.wasm 无导入） ---- */
ZTEST(framework_wasm, test_native_probe_principal_gate)
{
	entelea_wasm_test_reset();
	entelea_perm_test_reset();
	/* 授权 principal（gpio:read:0）→ 1（授权可见）。 */
	entelea_perm_table_t t;

	entelea_perm_table_init(&t);
	zassert_equal(entelea_perm_parse("gpio:read:0", &t), ENTELEA_OK);
	entelea_principal_t ok_ctx;

	zassert_equal(entelea_principal_bind(&ok_ctx, 1, &t), ENTELEA_OK);
	zassert_equal(entelea_wasm_test_probe_decide(ok_ctx, 0xFFFFFFFF), 1,
		      "注入授权身份 → 授权可见（Wasm 传参被忽略）");
	/* 未授权（空权限）→ E_PERM。 */
	entelea_perm_table_t empty;

	entelea_perm_table_init(&empty);
	entelea_principal_t poor;

	zassert_equal(entelea_principal_bind(&poor, 2, &empty), ENTELEA_OK);
	zassert_equal(entelea_wasm_test_probe_decide(poor, 0), ENTELEA_E_PERM,
		      "注入未授权身份 → E_PERM（不崩溃、不越权）");
	/* 伪造/过期句柄恒 E_PERM（principal 合同面：bind 唯一构造）。 */
	entelea_principal_t fake = {._handle = 91, .app_id = 0};

	zassert_equal(entelea_wasm_test_probe_decide(fake, 0), ENTELEA_E_PERM,
		      "伪造句柄 → E_PERM");
	entelea_perm_test_reset(); /* 用例序不保证：释放 principal 槽 */
}
```
