## firmware/app/boards/esp32p4c5_core_board_esp32p4_hpcore-store.conf
```kconfig
# SPDX-License-Identifier: Apache-2.0
CONFIG_FLASH=y
CONFIG_FLASH_MAP=y
CONFIG_TS_STORE_FLASH=y
CONFIG_TS_STORE_AUDIT=y
```

## firmware/tests/audio/testcase.yaml
```yaml
tests:
  framework.audio.pdm:
    tags:
      - framework
      - audio
    integration_platforms:
      - native_sim
    platform_allow:
      - native_sim
      - native_sim/native/64
    extra_args: TEST_AUDIO_PDM=1
  framework.audio.es8311:
    tags:
      - framework
      - audio
    integration_platforms:
      - native_sim
    platform_allow:
      - native_sim
      - native_sim/native/64
    extra_args: TEST_AUDIO_ES8311=1
```

## firmware/tests/board/p4cameraidf/sdkconfig.defaults
```kconfig
CONFIG_IDF_TARGET="esp32p4"
CONFIG_BOOTLOADER_LOG_LEVEL_WARN=y
CONFIG_ESPTOOLPY_FLASHMODE_DIO=y
CONFIG_ESPTOOLPY_FLASHSIZE_16MB=y
CONFIG_PARTITION_TABLE_CUSTOM=y
CONFIG_SPIRAM=y
CONFIG_SPIRAM_SPEED_250M=y
CONFIG_SPIRAM_XIP_FROM_PSRAM=y
CONFIG_FREERTOS_HZ=1000
CONFIG_CAMERA_SC2336=y
CONFIG_CAMERA_SC2336_MIPI_RAW8_1280X720_30FPS=y
CONFIG_ESP_VIDEO_ENABLE_ISP_PIPELINE_CONTROLLER=y
CONFIG_IDF_EXPERIMENTAL_FEATURES=y
```

## firmware/tests/board/p4wifibench/boards/esp32p4c5_core_board_esp32p4_hpcore-tls.conf
```kconfig
# SPDX-License-Identifier: Apache-2.0
# TLS-capable network diagnostic; credentials arrive over UART, not Kconfig.
CONFIG_P4W_SCAN_ONLY=n
CONFIG_P4W_NETWORK_ONLY=y
CONFIG_WIFI_LOG_LEVEL_DBG=n
CONFIG_WIFI_LOG_LEVEL_INF=y
CONFIG_WIFI_STA_AUTO_DHCPV4=n
CONFIG_NET_CONFIG_AUTO_INIT=n
CONFIG_NET_TCP=y
CONFIG_MAIN_STACK_SIZE=8192
CONFIG_STACK_SENTINEL=y
CONFIG_THREAD_NAME=y
CONFIG_THREAD_ANALYZER=y
CONFIG_THREAD_RUNTIME_STATS=n
CONFIG_MBEDTLS=y
CONFIG_MBEDTLS_SSL_PROTO_TLS1_2=y
CONFIG_MBEDTLS_CIPHERSUITE_TLS_ECDHE_ECDSA_WITH_AES_128_GCM_SHA256=y
CONFIG_MBEDTLS_ENABLE_HEAP=y
CONFIG_MBEDTLS_HEAP_SIZE=60000
CONFIG_MBEDTLS_HAVE_TIME_DATE=y
CONFIG_NET_SOCKETS_SOCKOPT_TLS=y
CONFIG_NET_SOCKETS_TLS_MAX_CONTEXTS=2
CONFIG_P4W_NETWORK_TLS=y
CONFIG_DNS_RESOLVER=y
CONFIG_DNS_RESOLVER_CACHE=n
CONFIG_NET_SOCKETS_DNS_TIMEOUT=3000
CONFIG_NET_SOCKETS_CONNECT_TIMEOUT=5000
CONFIG_NET_SOCKETS_TLS_CERT_VERIFY_CALLBACK=y
CONFIG_MBEDTLS_SSL_SERVER_NAME_INDICATION=y
```

## firmware/tests/core/testcase.yaml
```yaml
tests:
  framework.core:
    tags: framework
    integration_platforms:
      - native_sim
    platform_allow:
      - native_sim
      - native_sim/native/64
  framework.core.wdt_start_failures:
    tags: framework
    integration_platforms:
      - native_sim
    platform_allow:
      - native_sim
      - native_sim/native/64
    extra_args: TEST_WDT_START_FAILURES=ON
  framework.core.wdt_hardware:
    tags: framework
    integration_platforms:
      - native_sim
    platform_allow:
      - native_sim
      - native_sim/native/64
    extra_args:
      - TEST_WDT_HARDWARE=ON
      - DTC_OVERLAY_FILE=wdt.overlay
    extra_configs:
      - CONFIG_TS_WDT_REQUIRE_HW=y
      - CONFIG_TASK_WDT_MIN_TIMEOUT=5000
      - CONFIG_TASK_WDT_HW_FALLBACK_DELAY=5000
      - CONFIG_TASK_WDT_HW_FALLBACK_PAUSE_HALTED_BY_DBG=n
  framework.core.wdt_hardware_not_ready:
    tags: framework
    integration_platforms:
      - native_sim
    platform_allow:
      - native_sim
      - native_sim/native/64
    extra_args:
      - TEST_WDT_HARDWARE=ON
      - TEST_WDT_HW_NOT_READY=ON
      - DTC_OVERLAY_FILE=wdt.overlay
    extra_configs:
      - CONFIG_TS_WDT_REQUIRE_HW=y
      - CONFIG_TASK_WDT_MIN_TIMEOUT=5000
      - CONFIG_TASK_WDT_HW_FALLBACK_DELAY=5000
      - CONFIG_TASK_WDT_HW_FALLBACK_PAUSE_HALTED_BY_DBG=n
  framework.core.wdt_required_missing:
    tags: framework
    integration_platforms:
      - native_sim
    platform_allow:
      - native_sim
      - native_sim/native/64
    extra_args:
      - TEST_WDT_START_FAILURES=ON
      - TEST_WDT_REQUIRED_MISSING=ON
    extra_configs:
      - CONFIG_TS_WDT_REQUIRE_HW=y
```

## firmware/tests/periph/testcase.yaml
```yaml
tests:
  framework.periph.registration_failures:
    tags: framework
    integration_platforms:
      - native_sim
    platform_allow:
      - native_sim
      - native_sim/native/64
    extra_args: TEST_REGISTRATION_FAILURES=ON
  framework.periph:
    tags: framework
    integration_platforms:
      - native_sim
    platform_allow:
      - native_sim
      - native_sim/native/64
```

## firmware/tests/sd_diagnostic/testcase.yaml
```yaml
tests:
  framework.sd_diagnostic:
    tags:
      - framework
      - storage
    integration_platforms:
      - native_sim
    platform_allow:
      - native_sim
      - native_sim/native/64
```

## firmware/tests/touch_events/testcase.yaml
```yaml
tests:
  framework.touch_events:
    tags:
      - framework
      - input
    integration_platforms:
      - native_sim
    platform_allow:
      - native_sim
      - native_sim/native/64
```

## platform/zephyr/tests/safety/dts/bindings/entelea,fake-pwm.yaml
```yaml
# SPDX-License-Identifier: Apache-2.0
description: Entelea test fake PWM controller (captures ns, injects failures)

compatible: "entelea,fake-pwm"

include: base.yaml

properties:
  "#pwm-cells":
    type: int
    required: true
    const: 3

pwm-cells:
  - channel
  - period
  - flags
```
