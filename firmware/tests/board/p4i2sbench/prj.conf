## CMakeLists.txt
```
# SPDX-License-Identifier: Apache-2.0
cmake_minimum_required(VERSION 3.28.0)
find_package(Zephyr REQUIRED HINTS $ENV{ZEPHYR_BASE})
project(entelea_p4_i2s_diagnostic)

option(P04_I2S_WORD32 "Use 32-bit stereo slots" OFF)
option(P04_I2S_GDMA_CANDIDATE "Use isolated archived GDMA candidate" OFF)
option(P04_I2S_LIFECYCLE_TEST "Exercise normal STOP and restart" OFF)
if(P04_I2S_LIFECYCLE_TEST)
  if(NOT P04_I2S_WORD32)
    message(FATAL_ERROR "The P4 I2S lifecycle diagnostic requires 32-bit slots")
  endif()
  target_sources(app PRIVATE src/lifecycle.c)
else()
  target_sources(app PRIVATE src/main.c)
endif()

if(P04_I2S_WORD32)
  target_compile_definitions(app PRIVATE P04_I2S_WORD32)
endif()

if(P04_I2S_GDMA_CANDIDATE)
  include(gdma_candidate.cmake)
endif()
```

## Kconfig
```
# SPDX-License-Identifier: Apache-2.0
mainmenu "P4 I2S diagnostic"

source "Kconfig.zephyr"
```

## prj.conf
```kconfig
# SPDX-License-Identifier: Apache-2.0
CONFIG_TS_CORE=n
CONFIG_I2S=y
CONFIG_DMA=y
CONFIG_I2S_ESP32_RX_BLOCK_COUNT=8
CONFIG_I2S_ESP32_TX_BLOCK_COUNT=8
CONFIG_MAIN_STACK_SIZE=4096
CONFIG_LOG=y
```

## app.overlay
```dts
/* SPDX-License-Identifier: Apache-2.0 */
&i2s0 {
	status = "okay";
};
```

## src/main.c
```c
// SPDX-License-Identifier: Apache-2.0
#include <errno.h>
#include <stdint.h>
#include <zephyr/device.h>
#include <zephyr/drivers/i2s.h>
#include <zephyr/kernel.h>
#include <zephyr/sys/printk.h>
#include <rom/gpio.h>
#include <soc/gpio_sig_map.h>

#ifdef P04_I2S_WORD32
typedef uint32_t sample_t;
#define WORD_SIZE 32U
#define ENCODE(value) ((uint32_t)(value) << 16)
#define DECODE(value) ((uint16_t)((value) >> 16))
#define VALID_PADDING(value) (((value) & 0xffffU) == 0U)
#else
typedef uint16_t sample_t;
#define WORD_SIZE 16U
#define ENCODE(value) ((uint16_t)(value))
#define DECODE(value) ((uint16_t)(value))
#define VALID_PADDING(value) true
#endif

#define FRAMES_PER_BLOCK 256U
#define BLOCK_SIZE (FRAMES_PER_BLOCK * 2U * sizeof(sample_t))
#define PREFILL_BLOCKS 4U
#define RECEIVE_BLOCKS 48U
#define DATA_BASE 0x3000U

K_MEM_SLAB_DEFINE(rx_slab, BLOCK_SIZE, 12, 64);
K_MEM_SLAB_DEFINE(tx_slab, BLOCK_SIZE, 12, 64);

static const struct device *const i2s = DEVICE_DT_GET(DT_NODELABEL(i2s0));

static int enqueue(unsigned int block)
{
	sample_t *samples;
	int ret = k_mem_slab_alloc(&tx_slab, (void **)&samples, K_MSEC(1000));

	if (ret != 0) {
		return ret;
	}
	for (unsigned int i = 0; i < FRAMES_PER_BLOCK; ++i) {
		uint16_t left = (uint16_t)(DATA_BASE + block * FRAMES_PER_BLOCK + i);

		samples[2 * i] = ENCODE(left);
		samples[2 * i + 1] = ENCODE((uint16_t)(left ^ 0xa55aU));
	}
	ret = i2s_write(i2s, samples, BLOCK_SIZE);
	if (ret != 0) {
		k_mem_slab_free(&tx_slab, samples);
	}
	return ret;
}

static int cycle(unsigned int run)
{
	uint32_t expected = 0;
	uint32_t checked = 0;
	uint32_t first_frame = 0;
	uint32_t zero_pairs = 0;
	uint32_t reversed_pairs = 0;
	bool aligned = false;
	int ret;

	for (unsigned int b = 0; b < PREFILL_BLOCKS; ++b) {
		ret = enqueue(b);
		if (ret != 0) {
			printk("P4I2S FAIL prefill run=%u block=%u rc=%d\n", run, b, ret);
			return ret;
		}
	}
	ret = i2s_trigger(i2s, I2S_DIR_BOTH, I2S_TRIGGER_START);
	if (ret != 0) {
		printk("P4I2S FAIL start run=%u rc=%d\n", run, ret);
		return ret;
	}
	for (unsigned int b = 0; b < RECEIVE_BLOCKS; ++b) {
		sample_t *samples;
		size_t len;

		ret = i2s_read(i2s, (void **)&samples, &len);
		if (ret != 0) {
			printk("P4I2S FAIL read run=%u block=%u rc=%d\n", run, b, ret);
			return ret;
		}
		if (len != BLOCK_SIZE) {
			printk("P4I2S FAIL length run=%u block=%u len=%u\n", run, b,
			       (unsigned int)len);
			k_mem_slab_free(&rx_slab, samples);
			return -EMSGSIZE;
		}
		for (unsigned int i = 0; i < FRAMES_PER_BLOCK; ++i) {
			uint16_t left = DECODE(samples[2 * i]);
			uint16_t right = DECODE(samples[2 * i + 1]);

			if (!aligned) {
				zero_pairs += left == 0 && right == 0;
				reversed_pairs +=
					right >= DATA_BASE &&
					right < DATA_BASE + PREFILL_BLOCKS * FRAMES_PER_BLOCK &&
					left == (uint16_t)(right ^ 0xa55aU);
				if (left >= DATA_BASE &&
				    left < DATA_BASE + PREFILL_BLOCKS * FRAMES_PER_BLOCK &&
				    right == (uint16_t)(left ^ 0xa55aU)) {
					expected = left - DATA_BASE;
					first_frame = expected;
					aligned = true;
				} else {
					continue;
				}
			}
			uint16_t wanted = (uint16_t)(DATA_BASE + expected);

			if (left != wanted || right != (uint16_t)(wanted ^ 0xa55aU) ||
			    !VALID_PADDING(samples[2 * i]) || !VALID_PADDING(samples[2 * i + 1])) {
				printk("P4I2S FAIL data run=%u block=%u frame=%u expected=%04x "
				       "got=%04x/%04x checked=%u\n",
				       run, b, i, wanted, left, right, checked);
				k_mem_slab_free(&rx_slab, samples);
				return -EBADMSG;
			}
			++expected;
			++checked;
		}
		k_mem_slab_free(&rx_slab, samples);
		ret = enqueue(PREFILL_BLOCKS + b);
		if (ret != 0) {
			printk("P4I2S FAIL write run=%u block=%u rc=%d\n", run, b, ret);
			return ret;
		}
	}
	if (!aligned || checked < (RECEIVE_BLOCKS - 1U) * FRAMES_PER_BLOCK) {
		printk("P4I2S FAIL alignment run=%u checked=%u zero_pairs=%u reversed_pairs=%u\n",
		       run, checked, zero_pairs, reversed_pairs);
		return -EBADMSG;
	}
	ret = i2s_trigger(i2s, I2S_DIR_BOTH, I2S_TRIGGER_DROP);
	if (ret != 0) {
		printk("P4I2S FAIL drop run=%u rc=%d\n", run, ret);
		return ret;
	}
	void *after;
	size_t after_len;

	ret = i2s_read(i2s, &after, &after_len);
	if (ret == 0) {
		k_mem_slab_free(&rx_slab, after);
		printk("P4I2S FAIL read_after_drop run=%u len=%u\n", run, (unsigned int)after_len);
		return -EBADMSG;
	}
	if (ret != -EAGAIN) {
		printk("P4I2S FAIL read_after_drop run=%u rc=%d\n", run, ret);
		return ret;
	}
	printk("P4I2S CYCLE_PASS run=%u first_frame=%u checked=%u read_after_drop_rc=%d\n", run,
	       first_frame, checked, ret);
	return 0;
}

int main(void)
{
	struct i2s_config config = {
		.word_size = WORD_SIZE,
		.channels = 2,
		.format = I2S_FMT_DATA_FORMAT_I2S,
		.options = I2S_OPT_BIT_CLK_CONTROLLER | I2S_OPT_FRAME_CLK_CONTROLLER,
		.frame_clk_freq = 16000,
		.mem_slab = &tx_slab,
		.block_size = BLOCK_SIZE,
		.timeout = 1000,
	};
	int ret;

	if (!device_is_ready(i2s)) {
		printk("P4I2S FAIL device_not_ready\n");
		return 1;
	}
	ret = i2s_configure(i2s, I2S_DIR_TX, &config);
	if (ret == 0) {
		config.mem_slab = &rx_slab;
		ret = i2s_configure(i2s, I2S_DIR_RX, &config);
	}
	if (ret != 0) {
		printk("P4I2S FAIL configure rc=%d\n", ret);
		return 1;
	}
	rom_gpio_pad_input_enable(9);
	rom_gpio_matrix_in(9, I2S0_I_SD_PAD_IN_IDX, false);
	printk("P4I2S START internal_gpio9_loopback rate=16000 word=%u channels=2\n", WORD_SIZE);
	for (unsigned int run = 1; run <= 2; ++run) {
		ret = cycle(run);
		if (ret != 0) {
			int cleanup = i2s_trigger(i2s, I2S_DIR_BOTH, I2S_TRIGGER_DROP);

			printk("P4I2S END failure=%d cleanup=%d\n", ret, cleanup);
			return 1;
		}
	}
	printk("P4I2S PASS cycles=2\n");
	return 0;
}
```

## src/lifecycle.c
```c
// SPDX-License-Identifier: Apache-2.0
#include <errno.h>
#include <stdint.h>

#include <zephyr/device.h>
#include <zephyr/drivers/i2s.h>
#include <zephyr/kernel.h>
#include <zephyr/sys/printk.h>

#include <hal/gpio_ll.h>
#include <rom/gpio.h>
#include <soc/gpio_sig_map.h>

#define WORD_SIZE 32U
#define FRAMES_PER_BLOCK 256U
#define BLOCK_SIZE (FRAMES_PER_BLOCK * 2U * sizeof(uint32_t))
#define SLAB_BLOCKS 12U
#define PREFILL_BLOCKS 6U
#define BEFORE_BLOCKS 8U
#define AFTER_BLOCKS 4U
#define DATA_BASE 0x3000U
#define MAX_INITIAL_SKIP FRAMES_PER_BLOCK
#define CLOCK_QUIET_US 5000U
#define STOP_LIMIT_US 200000U

K_MEM_SLAB_DEFINE(rx_slab, BLOCK_SIZE, SLAB_BLOCKS, 64);
K_MEM_SLAB_DEFINE(tx_slab, BLOCK_SIZE, SLAB_BLOCKS, 64);

static const struct device *const i2s = DEVICE_DT_GET(DT_NODELABEL(i2s0));

struct sequence {
	uint32_t expected;
	uint32_t first;
	uint32_t checked;
	uint32_t skipped;
	bool aligned;
};

static int enqueue(unsigned int block)
{
	uint32_t *samples;
	int ret = k_mem_slab_alloc(&tx_slab, (void **)&samples, K_MSEC(250));

	if (ret != 0) {
		return ret;
	}
	for (unsigned int i = 0; i < FRAMES_PER_BLOCK; ++i) {
		uint16_t left = (uint16_t)(DATA_BASE + block * FRAMES_PER_BLOCK + i);

		samples[2 * i] = (uint32_t)left << 16;
		samples[2 * i + 1] = (uint32_t)(uint16_t)(left ^ 0xa55aU) << 16;
	}
	ret = i2s_write(i2s, samples, BLOCK_SIZE);
	if (ret != 0) {
		k_mem_slab_free(&tx_slab, samples);
	}
	return ret;
}

static int check_block(struct sequence *seq, const uint32_t *samples)
{
	for (unsigned int i = 0; i < FRAMES_PER_BLOCK; ++i) {
		uint16_t left = (uint16_t)(samples[2 * i] >> 16);
		uint16_t right = (uint16_t)(samples[2 * i + 1] >> 16);

		if (!seq->aligned) {
			if (left >= DATA_BASE &&
			    left < DATA_BASE + (PREFILL_BLOCKS + BEFORE_BLOCKS + AFTER_BLOCKS) *
						       FRAMES_PER_BLOCK &&
			    right == (uint16_t)(left ^ 0xa55aU)) {
				seq->expected = left;
				seq->first = left;
				seq->aligned = true;
			} else if (++seq->skipped <= MAX_INITIAL_SKIP) {
				continue;
			} else {
				printk("P4STOP FAIL alignment skipped=%u\n", seq->skipped);
				return -EBADMSG;
			}
		}
		if (left != (uint16_t)seq->expected ||
		    right != (uint16_t)((uint16_t)seq->expected ^ 0xa55aU) ||
		    (samples[2 * i] & 0xffffU) != 0U || (samples[2 * i + 1] & 0xffffU) != 0U) {
			printk("P4STOP FAIL data expected=%04x got=%04x/%04x checked=%u\n",
			       (uint16_t)seq->expected, left, right, seq->checked);
			return -EBADMSG;
		}
		++seq->expected;
		++seq->checked;
	}
	return 0;
}

static int receive(struct sequence *seq)
{
	void *samples;
	size_t len;
	int ret = i2s_read(i2s, &samples, &len);

	if (ret != 0) {
		return ret;
	}
	if (len != BLOCK_SIZE) {
		printk("P4STOP FAIL length=%u\n", (unsigned int)len);
		ret = -EMSGSIZE;
	} else {
		ret = check_block(seq, samples);
	}
	k_mem_slab_free(&rx_slab, samples);
	return ret;
}

static unsigned int ws_edges(unsigned int duration_us)
{
	uint64_t start = k_cycle_get_64();
	uint32_t last = gpio_ll_get_level(&GPIO, 10);
	unsigned int edges = 0;

	while (k_cyc_to_us_floor64(k_cycle_get_64() - start) < duration_us) {
		uint32_t level = gpio_ll_get_level(&GPIO, 10);

		if (level != last) {
			++edges;
			last = level;
		}
	}
	return edges;
}

static int wait_for_quiet(uint64_t start, uint32_t *elapsed_us)
{
	while (k_cyc_to_us_floor64(k_cycle_get_64() - start) < STOP_LIMIT_US) {
		if (ws_edges(CLOCK_QUIET_US) == 0U) {
			*elapsed_us = (uint32_t)k_cyc_to_us_floor64(k_cycle_get_64() - start);
			return *elapsed_us <= STOP_LIMIT_US ? 0 : -ETIMEDOUT;
		}
	}
	return -ETIMEDOUT;
}

static int cycle(unsigned int run)
{
	struct sequence before = {0};
	struct sequence after = {0};
	unsigned int next_block = 0;
	unsigned int drained = 0;
	unsigned int free_tx;
	uint32_t stop_us = 0;
	uint64_t start;
	int ret;

	for (; next_block < PREFILL_BLOCKS; ++next_block) {
		ret = enqueue(next_block);
		if (ret != 0) {
			printk("P4STOP FAIL prefill run=%u rc=%d\n", run, ret);
			return ret;
		}
	}
	ret = i2s_trigger(i2s, I2S_DIR_BOTH, I2S_TRIGGER_START);
	if (ret != 0) {
		printk("P4STOP FAIL start run=%u rc=%d\n", run, ret);
		return ret;
	}
	unsigned int edges = ws_edges(CLOCK_QUIET_US);

	if (edges < 30U) {
		printk("P4STOP FAIL running_clock run=%u edges=%u\n", run, edges);
		return -EIO;
	}
	for (unsigned int i = 0; i < BEFORE_BLOCKS; ++i) {
		ret = receive(&before);
		if (ret != 0) {
			printk("P4STOP FAIL before run=%u block=%u rc=%d\n", run, i, ret);
			return ret;
		}
		ret = enqueue(next_block++);
		if (ret != 0) {
			printk("P4STOP FAIL write_before run=%u block=%u rc=%d\n", run, i, ret);
			return ret;
		}
	}
	start = k_cycle_get_64();
	ret = i2s_trigger(i2s, I2S_DIR_BOTH, I2S_TRIGGER_STOP);
	if (ret != 0) {
		printk("P4STOP FAIL stop run=%u rc=%d\n", run, ret);
		return ret;
	}
	ret = wait_for_quiet(start, &stop_us);
	if (ret != 0) {
		printk("P4STOP FAIL clock_not_quiet run=%u rc=%d\n", run, ret);
		return ret;
	}
	do {
		ret = receive(&before);
		if (ret == 0) {
			++drained;
		}
	} while (ret == 0 && drained <= SLAB_BLOCKS);
	if (ret != -EAGAIN || drained == 0U || drained > SLAB_BLOCKS) {
		printk("P4STOP FAIL drain run=%u blocks=%u rc=%d\n", run, drained, ret);
		return -EIO;
	}
	if (ws_edges(CLOCK_QUIET_US) != 0U) {
		printk("P4STOP FAIL clock_restarted run=%u\n", run);
		return -EIO;
	}
	free_tx = k_mem_slab_num_free_get(&tx_slab);
	if (free_tx >= SLAB_BLOCKS) {
		printk("P4STOP FAIL tx_queue_not_preserved run=%u free=%u\n", run, free_tx);
		return -EIO;
	}
	ret = i2s_trigger(i2s, I2S_DIR_BOTH, I2S_TRIGGER_START);
	if (ret != 0) {
		printk("P4STOP FAIL resume run=%u rc=%d free_tx=%u\n", run, ret, free_tx);
		return ret;
	}
	for (unsigned int i = 0; i < AFTER_BLOCKS; ++i) {
		ret = receive(&after);
		if (ret != 0) {
			printk("P4STOP FAIL after run=%u block=%u rc=%d\n", run, i, ret);
			return ret;
		}
		ret = enqueue(next_block++);
		if (ret != 0) {
			printk("P4STOP FAIL write_after run=%u block=%u rc=%d\n", run, i, ret);
			return ret;
		}
	}
	if (!after.aligned || after.skipped != 0U || after.first != before.expected) {
		printk("P4STOP FAIL resume_continuity run=%u expected=%04x got=%04x skipped=%u\n",
		       run, before.expected, after.first, after.skipped);
		return -EBADMSG;
	}
	if (before.checked < (BEFORE_BLOCKS - 1U) * FRAMES_PER_BLOCK ||
	    after.checked < (AFTER_BLOCKS - 1U) * FRAMES_PER_BLOCK) {
		printk("P4STOP FAIL checked run=%u before=%u after=%u\n", run, before.checked,
		       after.checked);
		return -EBADMSG;
	}
	ret = i2s_trigger(i2s, I2S_DIR_BOTH, I2S_TRIGGER_DROP);
	if (ret != 0) {
		printk("P4STOP FAIL drop run=%u rc=%d\n", run, ret);
		return ret;
	}
	void *block;
	size_t len;

	ret = i2s_read(i2s, &block, &len);
	if (ret == 0) {
		k_mem_slab_free(&rx_slab, block);
		printk("P4STOP FAIL read_after_drop run=%u len=%u\n", run, (unsigned int)len);
		return -EIO;
	}
	if (ret != -EAGAIN || k_mem_slab_num_free_get(&tx_slab) != SLAB_BLOCKS ||
	    k_mem_slab_num_free_get(&rx_slab) != SLAB_BLOCKS) {
		printk("P4STOP FAIL cleanup run=%u rc=%d tx_free=%u rx_free=%u\n", run, ret,
		       k_mem_slab_num_free_get(&tx_slab), k_mem_slab_num_free_get(&rx_slab));
		return -EIO;
	}
	printk("P4STOP CYCLE_PASS run=%u clock_edges=%u stop_us=%u drained=%u "
	       "queued_tx=%u before=%u after=%u\n",
	       run, edges, stop_us, drained, SLAB_BLOCKS - free_tx, before.checked, after.checked);
	return 0;
}

int main(void)
{
	struct i2s_config config = {
		.word_size = WORD_SIZE,
		.channels = 2,
		.format = I2S_FMT_DATA_FORMAT_I2S,
		.options = I2S_OPT_BIT_CLK_CONTROLLER | I2S_OPT_FRAME_CLK_CONTROLLER,
		.frame_clk_freq = 16000,
		.mem_slab = &tx_slab,
		.block_size = BLOCK_SIZE,
		.timeout = 250,
	};
	int ret;

	if (!device_is_ready(i2s)) {
		printk("P4STOP FAIL device_not_ready\n");
		return 1;
	}
	ret = i2s_configure(i2s, I2S_DIR_TX, &config);
	if (ret == 0) {
		config.mem_slab = &rx_slab;
		ret = i2s_configure(i2s, I2S_DIR_RX, &config);
	}
	if (ret != 0) {
		printk("P4STOP FAIL configure rc=%d\n", ret);
		return 1;
	}
	rom_gpio_pad_input_enable(9);
	rom_gpio_pad_input_enable(10);
	rom_gpio_matrix_in(9, I2S0_I_SD_PAD_IN_IDX, false);
	printk("P4STOP START rate=16000 word=32 channels=2 stop_limit_us=%u\n", STOP_LIMIT_US);
	for (unsigned int run = 1; run <= 2; ++run) {
		ret = cycle(run);
		if (ret != 0) {
			int cleanup = i2s_trigger(i2s, I2S_DIR_BOTH, I2S_TRIGGER_DROP);

			printk("P4STOP END failure=%d cleanup=%d\n", ret, cleanup);
			return 1;
		}
	}
	printk("P4STOP PASS cycles=2\n");
	return 0;
}
```
